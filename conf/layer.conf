## conf/layer.conf
```bitbake
# We have a conf and classes directory, add to BBPATH
BBPATH .= ":${LAYERDIR}"

# Layer path to use from bbfiles
PETALINUX_TOOLS_LAYER = "${LAYERDIR}"

# We have recipes-* directories, add to BBFILES
BBFILES += "${LAYERDIR}/recipes-*/*/*.bb \
            ${LAYERDIR}/recipes-*/*/*.bbappend"

BBFILES_DYNAMIC += " \
	xilinx-standalone-sdt:${LAYERDIR}/dynamic-layers/xilinx-standalone-sdt/recipes-*/*/*.bb \
	xilinx-standalone-sdt:${LAYERDIR}/dynamic-layers/xilinx-standalone-sdt/recipes-*/*/*.bbappend \
"

BBFILE_COLLECTIONS += "petalinux-tools"
BBFILE_PATTERN_petalinux-tools = "^${LAYERDIR}/"
BBFILE_PRIORITY_petalinux-tools = "6"

LAYERDEPENDS_petalinux-tools = "\
	core \
	xilinx \
	petalinux"

LAYERSERIES_COMPAT_petalinux-tools = "langdale scarthgap"
```
